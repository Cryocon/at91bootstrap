## board/at91sam9x5ek/cryocon_defconfig
```kconfig
HAVE_DOT_CONFIG=y
CONFIG_BOARDNAME="at91sam9x5ek"
CONFIG_AT91SAM9X5EK=y
CONFIG_CHIP="AT91SAM9X5"
CONFIG_BOARD="at91sam9x5ek"
CONFIG_MACH_TYPE="3373"
CONFIG_LINK_ADDR="0x000000"
CONFIG_TOP_OF_MEMORY="0x308000"
CONFIG_CRYSTAL_12_000MHZ=y
ALLOW_CRYSTAL_12_000MHZ=y
CONFIG_CRYSTAL="CRYSTAL_12_000MHZ"
CONFIG_CPU_CLK_400MHZ=y
ALLOW_CPU_CLK_400MHZ=y
CONFIG_BUS_SPEED_133MHZ=y
ALLOW_PIO3=y
CONFIG_HAS_PIO3=y
CPU_HAS_PMECC=y
CONFIG_DDR2=y
ALLOW_DATAFLASH=y
# ALLOW_FLASH is not set
ALLOW_NANDFLASH=y
ALLOW_SDCARD=y
ALLOW_HSMCI=y
CONFIG_RAM_128MB=y
CONFIG_SDCARD=y
CONFIG_MEMORY="sdcard"
CONFIG_SDCARD_HS=y
CONFIG_FATFS=y
CONFIG_LONG_FILENAME=y
ALLOW_DATAFLASH_RECOVERY=y
ALLOW_BOOT_FROM_DATAFLASH_CS0=y
ALLOW_NANDFLASH_RECOVERY=y
CONFIG_BOOTSTRAP_MAXSIZE="23000"
CONFIG_PROJECT="sdcard"
CONFIG_LOAD_LINUX=y
CONFIG_OS_MEM_BANK="0x20000000"
CONFIG_OS_MEM_SIZE="0x8000000"
CONFIG_LINUX_KERNEL_ARG_STRING="mem=128M console=ttyS0,115200 root=/dev/mmcblk0p2 ro rootwait"
CONFIG_OS_IMAGE_NAME="uImage"
CONFIG_JUMP_ADDR="0x22000000"
CONFIG_IMAGE_NAME="linux"
CONFIG_HW_INIT=y
CONFIG_USER_HW_INIT=y
CONFIG_SCLK=y
```
